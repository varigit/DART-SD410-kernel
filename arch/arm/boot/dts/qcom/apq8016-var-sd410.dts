/* Copyright (c) 2015, The Linux Foundation. All rights reserved.
*
* This program is free software; you can redistribute it and/or modify
* it under the terms of the GNU General Public License version 2 and
* only version 2 as published by the Free Software Foundation.
*
* This program is distributed in the hope that it will be useful,
* but WITHOUT ANY WARRANTY; without even the implied warranty of
* MERCHANTABILITY or FITNESS FOR A PARTICULAR PURPOSE.  See the
* GNU General Public License for more details.
*/

/dts-v1/;

#include "apq8016.dtsi"
#include "apq8016-var-sd410.dtsi"


/ {
	model = "Variscite VAR-DT410CustomBoard";
	compatible = "qcom,apq8016";
	qcom,msm-id = <206 0>, <247 0>;
	qcom,board-id = <24 0>;
};
