&mdss_mdp {
    dsi_sciaps_com35h3n: qcom,mdss_dsi_sciaps_com35h3n {
            qcom,mdss-dsi-panel-name = "ortustech com35h3n video mode panel v1.0";
            qcom,mdss-dsi-panel-controller = <&mdss_dsi0>;
            qcom,mdss-dsi-panel-type = "dsi_video_mode";
            qcom,mdss-dsi-panel-destination = "display_1";
            qcom,mdss-dsi-panel-framerate = <60>;
            qcom,mdss-dsi-virtual-channel-id = <0>;
            qcom,mdss-dsi-stream = <0>;
            qcom,mdss-dsi-panel-width = <480>;
            qcom,mdss-dsi-panel-height = <640>;
            qcom,mdss-dsi-h-front-porch = <16>;
            qcom,mdss-dsi-h-back-porch = <16>;
            qcom,mdss-dsi-h-pulse-width = <16>;
            qcom,mdss-dsi-h-sync-skew = <0>;
            qcom,mdss-dsi-v-back-porch = <16>;
            qcom,mdss-dsi-v-front-porch = <52>;
            qcom,mdss-dsi-v-pulse-width = <4>;
            qcom,mdss-dsi-h-left-border = <0>;
            qcom,mdss-dsi-h-right-border = <0>;
            qcom,mdss-dsi-v-top-border = <0>;
            qcom,mdss-dsi-v-bottom-border = <0>;
			qcom,mdss-dsi-bpp = <24>;
            qcom,mdss-dsi-underflow-color = <0xff>;
            qcom,mdss-dsi-border-color = <0>;
            qcom,mdss-dsi-on-command-state = "dsi_lp_mode";
            qcom,mdss-dsi-off-command-state = "dsi_hs_mode";
            qcom,mdss-dsi-h-sync-pulse = <1>;
            qcom,mdss-dsi-traffic-mode = "non_burst_sync_pulse";
            qcom,mdss-dsi-bllp-eof-power-mode;
            qcom,mdss-dsi-bllp-power-mode;
            qcom,mdss-dsi-lane-0-state;
            qcom,mdss-dsi-lane-1-state;
            qcom,mdss-dsi-panel-timings = [4A 10 0A 00 30 34 0E 14 0C 03 04 00];
            qcom,mdss-dsi-t-clk-post = <5>;
            qcom,mdss-dsi-t-clk-pre = <18>;
            qcom,mdss-dsi-dma-trigger = "trigger_sw";
            qcom,mdss-dsi-mdp-trigger = "none";
            qcom,mdss-dsi-bl-pmic-control-type = "bl_ctrl_pwm";
            qcom,mdss-dsi-bl-pmic-pwm-frequency = <50>;
            qcom,mdss-dsi-bl-pmic-bank-select = <0>;
            qcom,mdss-dsi-pwm-gpio = <&pm8916_mpps 4 0>;
            qcom,mdss-dsi-reset-sequence = <1 10>;//selects DSI routing to DSI to LVDS bridge
            qcom,mdss-pan-physical-width-dimension = <53>;
            qcom,mdss-pan-physical-height-dimension = <71>;
			qcom,mdss-dsi-on-command = [
				39 01 00 00 00 00 06 FF FF 98 06 04 01
				15 01 00 00 00 00 02 08 18
				15 01 00 00 00 00 02 21 01
				15 01 00 00 00 00 02 30 30
				15 01 00 00 00 00 02 31 00
				15 01 00 00 00 00 02 60 0D
				15 01 00 00 00 00 02 61 08
				15 01 00 00 00 00 02 62 08
				15 01 00 00 00 00 02 63 09
				15 01 00 00 00 00 02 40 30
				15 01 00 00 00 00 02 41 44
				15 01 00 00 00 00 02 42 00
				15 01 00 00 00 00 02 43 89
				15 01 00 00 00 00 02 44 8E
				15 01 00 00 00 00 02 45 D9
				15 01 00 00 00 00 02 46 33
				15 01 00 00 00 00 02 47 33
				15 01 00 00 00 00 02 50 90
				15 01 00 00 00 00 02 51 90
				15 01 00 00 00 00 02 56 00
				15 01 00 00 00 00 02 A0 00
				15 01 00 00 00 00 02 A1 0C
				15 01 00 00 00 00 02 A2 13
				15 01 00 00 00 00 02 A3 0F
				15 01 00 00 00 00 02 A4 0A
				15 01 00 00 00 00 02 A5 0D
				15 01 00 00 00 00 02 A6 0C
				15 01 00 00 00 00 02 A7 0B
				15 01 00 00 00 00 02 A8 01
				15 01 00 00 00 00 02 A9 06
				15 01 00 00 00 00 02 AA 15
				15 01 00 00 00 00 02 AB 07
				15 01 00 00 00 00 02 AC 12
				15 01 00 00 00 00 02 AD 28
				15 01 00 00 00 00 02 AE 20
				15 01 00 00 00 00 02 AF 14
				15 01 00 00 00 00 02 C0 00
				15 01 00 00 00 00 02 C1 0C
				15 01 00 00 00 00 02 C2 13
				15 01 00 00 00 00 02 C3 0F
				15 01 00 00 00 00 02 C4 09
				15 01 00 00 00 00 02 C5 0D
				15 01 00 00 00 00 02 C6 0C
				15 01 00 00 00 00 02 C7 0B
				15 01 00 00 00 00 02 C8 01
				15 01 00 00 00 00 02 C9 06
				15 01 00 00 00 00 02 CA 14
				15 01 00 00 00 00 02 CB 07
				15 01 00 00 00 00 02 CC 0F
				15 01 00 00 00 00 02 CD 21
				15 01 00 00 00 00 02 CE 17
				15 01 00 00 00 00 02 CF 0A
				39 01 00 00 00 00 06 FF FF 98 06 04 07
				15 01 00 00 00 00 02 06 00
				15 01 00 00 00 00 02 18 1D
				15 01 00 00 00 00 02 17 32
				39 01 00 00 00 00 06 FF FF 98 06 04 06
				15 01 00 00 00 00 02 00 20
				15 01 00 00 00 00 02 01 02
				15 01 00 00 00 00 02 02 00
				15 01 00 00 00 00 02 03 02
				15 01 00 00 00 00 02 04 01
				15 01 00 00 00 00 02 05 01
				15 01 00 00 00 00 02 06 88
				15 01 00 00 00 00 02 07 00
				15 01 00 00 00 00 02 08 01
				15 01 00 00 00 00 02 09 80
				15 01 00 00 00 00 02 0A 00
				15 01 00 00 00 00 02 0B 00
				15 01 00 00 00 00 02 0C 01
				15 01 00 00 00 00 02 0D 01
				15 01 00 00 00 00 02 0E 00
				15 01 00 00 00 00 02 0F 00
				15 01 00 00 00 00 02 10 55
				15 01 00 00 00 00 02 11 50
				15 01 00 00 00 00 02 12 01
				15 01 00 00 00 00 02 13 00
				15 01 00 00 00 00 02 14 00
				15 01 00 00 00 00 02 15 43
				15 01 00 00 00 00 02 16 0B
				15 01 00 00 00 00 02 17 00
				15 01 00 00 00 00 02 18 00
				15 01 00 00 00 00 02 19 00
				15 01 00 00 00 00 02 1A 00
				15 01 00 00 00 00 02 1B 00
				15 01 00 00 00 00 02 1C 00
				15 01 00 00 00 00 02 1D 00
				15 01 00 00 00 00 02 20 01
				15 01 00 00 00 00 02 21 23
				15 01 00 00 00 00 02 22 45
				15 01 00 00 00 00 02 23 67
				15 01 00 00 00 00 02 24 01
				15 01 00 00 00 00 02 25 23
				15 01 00 00 00 00 02 26 45
				15 01 00 00 00 00 02 27 67
				15 01 00 00 00 00 02 30 02
				15 01 00 00 00 00 02 31 22
				15 01 00 00 00 00 02 32 22
				15 01 00 00 00 00 02 33 88
				15 01 00 00 00 00 02 34 AA
				15 01 00 00 00 00 02 35 BB
				15 01 00 00 00 00 02 36 66
				15 01 00 00 00 00 02 37 22
				15 01 00 00 00 00 02 38 22
				15 01 00 00 00 00 02 39 22
				15 01 00 00 00 00 02 3A 22
				15 01 00 00 00 00 02 3B 22
				15 01 00 00 00 00 02 3C 22
				15 01 00 00 00 00 02 3D 22
				15 01 00 00 00 00 02 3E 22
				15 01 00 00 00 00 02 3F 22
				15 01 00 00 00 00 02 40 22
				15 01 00 00 00 00 02 53 12
				39 01 00 00 00 00 06 FF FF 98 06 04 00
				15 01 00 00 00 00 02 3A 60
				05 01 00 00 78 00 01 11
				05 01 00 00 10 00 01 29
			];
            qcom,mdss-dsi-off-command = [
                05 01 00 00 10 00 01 28
                05 01 00 00 10 00 01 10
            ];
    };

};
