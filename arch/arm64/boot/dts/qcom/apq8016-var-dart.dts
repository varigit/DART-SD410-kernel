/*
 * Copyright (c) 2015, The Linux Foundation. All rights reserved.
 *
 * This program is free software; you can redistribute it and/or modify
 * it under the terms of the GNU General Public License version 2 and
 * only version 2 as published by the Free Software Foundation.
 *
 * This program is distributed in the hope that it will be useful,
 * but WITHOUT ANY WARRANTY; without even the implied warranty of
 * MERCHANTABILITY or FITNESS FOR A PARTICULAR PURPOSE.  See the
 * GNU General Public License for more details.
 */

/dts-v1/;

#include "apq8016-var-dart.dtsi"

#ifdef HDMI_DISPLAY
	#include "apq8016-var-dart-hdmi.dtsi"
#else
	#include "apq8016-var-dart-lvds.dtsi"
#endif
/ {
	model = "Variscite LTD. VAR-DART410";
	compatible ="qcom,apq8016-dart", "qcom,apq8016", "qcom,dart";
};
