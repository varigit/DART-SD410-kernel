## drivers/sciaps/Kconfig
```kconfig
#
# SciAps Device Drivers
#

menuconfig SCIAPS_DRIVERS
	bool "SciAps drivers"
	depends on HAS_IOMEM
	help
		SciAps drivers

if SCIAPS_DRIVERS
config CONFIG_SCIAPS_TI_ADS7841_SPI
	tristate "SciAps TI ADS7841 Driver"
	depends on SCIAPS_DRIVERS && SPI_MASTER
	default n
	help
	  TI ADS7841 Support 

config CONFIG_SCIAPS_TI_DAC7513_SPI
	tristate "SciAps TI DAC7513 Driver"
	depends on SCIAPS_DRIVERS && SPI_MASTER
	default n
	help
	  TI DAC7513 Support 
endif #SCIAPS_DRIVERS
```

## drivers/video/msm/mdss/Kconfig
```kconfig
config FB_MSM_MDSS_WRITEBACK
	bool "MDSS Writeback Panel"
	---help---
	The MDSS Writeback Panel provides support for routing the output of
	MDSS frame buffer driver and MDP processing to memory.

config FB_MSM_MDSS_HDMI_PANEL
	depends on FB_MSM_MDSS
	bool "MDSS HDMI Tx Panel"
	default n
	---help---
	The MDSS HDMI Panel provides support for transmitting TMDS signals of
	MDSS frame buffer data to connected hdmi compliant TVs, monitors etc.

config FB_MSM_MDSS_HDMI_MHL_SII8334
	depends on FB_MSM_MDSS_HDMI_PANEL
	bool 'MHL SII8334 support '
	default n
	---help---
	  Support the HDMI to MHL conversion.
	  MHL (Mobile High-Definition Link) technology
	  uses USB connector to output HDMI content

config FB_MSM_MDSS_DSI_CTRL_STATUS
	tristate "DSI controller status check feature"
	---help---
	  Check DSI controller status periodically (default period is 5
	  seconds) by sending Bus-Turn-Around (BTA) command. If DSI controller
	  fails to acknowledge the BTA command, it sends PANEL_ALIVE=0 status
	  to HAL layer to reset the controller.

config FB_MSM_MDSS_EDP_PANEL
	depends on FB_MSM_MDSS
	bool "MDSS eDP Panel"
	---help---
	The MDSS eDP Panel provides support for eDP host controller driver
	which runs in Video mode only and is responsible for transmitting
	frame buffer from host SOC to eDP display panel.

config FB_MSM_MDSS_MDP3
	depends on FB_MSM_MDSS
	bool "MDP3 display controller"
	---help---
	The MDP3 provides support for an older version display controller
	included in latest display sub-system, known as MDSS.

config FB_MSM_MDSS_SPLASH_SCIAPS_AYW_RUSTY
	bool "MDSS Splash Logo Sciaps Analyze Your World - Rusty "
	default n
	---help---
	MDSS Splash Logo Sciaps Analyze Your World - Rusty 

config FB_MSM_MDSS_SPLASH_SCIAPS_AYW_BW
	bool "MDSS Splash Logo Sciaps Analyze Your World - Black and White"
	default n
	---help---
	MDSS Splash Logo Sciaps Analyze Your World - Black and White

config FB_MSM_MDSS_SPLASH_SCIAPS_X550
	bool "MDSS Splash Logo Sciaps X-550"
	default n
	---help---
	MDSS Splash Logo Sciaps Logo X-550

config FB_MSM_MDSS_SPLASH_SCIAPS_X_WITH_STROKE
	bool "MDSS Splash Logo Sciaps X With Stroke"
	default n
	---help---
	MDSS Splash Logo Sciaps Logo X with Stroke

config FB_MSM_MDSS_SPLASH_SCIAPS_X_WITHOUT_STROKE
	bool "MDSS Splash Logo Sciaps X Without Stroke"
	default n
	---help---
	MDSS Splash Logo Sciaps Logo X without stroke

config FB_MSM_MDSS_SPLASH_SCIAPS_X550_SCR
	bool "MDSS Splash Logo Sciaps X-550 113x124"
	default n
	---help---
	MDSS Splash Logo Sciaps Logo X-550 SCR 113x124
```
